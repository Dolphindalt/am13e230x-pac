# AM13E230x register map
Vendor: Texas Instruments; File version: Revised: 2025-12-26 17:30:06
ARM Device
CPU: CM33 r0p0, little endian, MPU, FPU, 4 interrupt priority bits
Registers are 32-bit, read-write, reset 0x0 unless marked. A register's access mark holds for its fields unless they carry their own. Offsets are from the block's base; lines under a group give offsets from that group; [hi:lo] are bit positions; {n}, {i} and the like mark numbered series; 'fields as' and 'values as' point back to an identical list; <NAME> marks a mode.

## Memory map
0x40000000 ADC0 size 0x2000
0x40002000 ADC1 size 0x2000
0x40004000 ADC2 size 0x2000
0x4000A000 ADC0_RESULT size 0x100
0x4000B000 ADC1_RESULT size 0x100
0x4000C000 ADC2_RESULT size 0x100
0x40010000 MCPWM0 size 0x800 — MCPWM_6CH_REGS
0x40011000 MCPWM1 size 0x800
0x40012000 MCPWM2 size 0x800
0x40013000 MCPWM3 size 0x800
0x40014000 MCPWM4 size 0x800
0x4001A000 EPI0 size 0x364 — External peripheral interface
0x40020000 DMA size 0x1C00 — PERIPHERALREGION
0x40028000 FRI size 0x2000 — FLASH_CTRL_REGS
0x4002A000 MEMCFG size 0x2000 — MEM_CFG_REGS
0x4002C000 EAM size 0x2000 — EAM_REGS
0x40042000 NVMNW size 0x2000 — F65NW
0x40046000 GSC size 0x2000 — GSC_LITE_INTERNAL_REGS
0x400AF000 SYSCTL size 0x1500 — mem_map
0x400C7000 DEBUGSS size 0x1F00 — DSSM
0x400CC000 IOMUX size 0x1000 — PERIPHERALREGION
0x400D0000 WWDT size 0x1500
0x400F0000 GPIO0 size 0x1D00 — PERIPHERALREGION
0x400F2000 GPIO1 size 0x1D00
0x400F4000 GPIO2 size 0x1D00
0x400F6000 GPIO3 size 0x1D00
0x400FC000 PGA0 size 0x2A — PGA_REGS
0x400FD000 PGA1 size 0x2A
0x400FE000 PGA2 size 0x2A
0x40110000 MCAN size 0x8000 — PERIPHERALREGION
0x40180000 TIMG4 size 0x1D00 — PERIPHERALREGION
0x40188000 TIMG12 size 0x1D00
0x401B0000 AES size 0x1200 — PERIPHERALREGION
0x401B2000 CRCP size 0x2000 — PERIPHERALREGION
0x401B6000 KEYSTORECTL size 0x2000 — PERIPHERALREGION
0x40440000 ECAP0 size 0x40 — ECAP_REGS
0x40441000 ECAP1 size 0x40
0x40448000 EQEP0 size 0x80 — EQEP_REGS
0x40449000 EQEP1 size 0x80
0x4044A000 EQEP2 size 0x80
0x40460000 CMPSS0 size 0x80 — CMPSS_LITE_REGS
0x40461000 CMPSS1 size 0x80
0x40462000 CMPSS2 size 0x80
0x40463000 CMPSS3 size 0x80
0x40468000 INPUTXBAR size 0x1000 — INPUT_XBAR_REGS
0x40469000 PWMXBAR size 0x1000 — EPWM_XBAR_REGS
0x4046A000 OUTPUTXBAR size 0x1000 — OUTPUTXBAR_REGS
0x4046B000 SYNC_SOC size 0x1000 — SYNC_SOC_REGS
0x40470000 OUTPUTXBAR0_FLAGS size 0x1000 — OUTPUTXBAR_FLAG_REGS
0x40471000 OUTPUTXBAR1_FLAGS size 0x1000
0x40472000 OUTPUTXBAR2_FLAGS size 0x1000
0x40473000 OUTPUTXBAR3_FLAGS size 0x1000
0x40474000 OUTPUTXBAR4_FLAGS size 0x1000
0x40475000 OUTPUTXBAR5_FLAGS size 0x1000
0x40476000 OUTPUTXBAR6_FLAGS size 0x1000
0x40477000 OUTPUTXBAR7_FLAGS size 0x1000
0x40490000 INPUTXBAR_FLAGS size 0x1000 — INPUT_FLAG_XBAR_REGS
0x40600000 UC0_UART size 0x500 — PERIPHERALREGION
0x40601000 UC1_UART size 0x500
0x40602000 UC2_UART size 0x500
0x40608000 UC0_I2CC size 0x500 — PERIPHERALREGION
0x40609000 UC1_I2CC size 0x500
0x4060A000 UC2_I2CC size 0x500
0x40610000 UC0_I2CT size 0x500 — PERIPHERALREGION
0x40611000 UC1_I2CT size 0x500
0x40612000 UC2_I2CT size 0x500
0x40618000 UC0_SPI size 0x200 — PERIPHERALREGION
0x40619000 UC1_SPI size 0x200
0x40630000 UNICOMM0 size 0x1C00 — PERIPHERALREGION
0x40632000 UNICOMM1 size 0x1C00
0x40634000 UNICOMM2 size 0x1C00
0x4063F000 SPGSS0 size 0xD00 — PERIPHERALREGION
0x40640000 UC3_UART size 0x500
0x40641000 UC4_UART size 0x500
0x40642000 UC5_UART size 0x500
0x40648000 UC3_I2CC size 0x500
0x40649000 UC4_I2CC size 0x500
0x4064A000 UC5_I2CC size 0x500
0x40650000 UC3_I2CT size 0x500
0x40651000 UC4_I2CT size 0x500
0x40652000 UC5_I2CT size 0x500
0x40658000 UC3_SPI size 0x200
0x40659000 UC4_SPI size 0x200
0x40670000 UNICOMM3 size 0x1C00
0x40672000 UNICOMM4 size 0x1C00
0x40674000 UNICOMM5 size 0x1C00
0x4067F000 SPGSS1 size 0xD00
0x408FF000 TINIELITE size 0x3F00 — PERIPHERALREGION
0x60111000 FACTORYREGION size 0x78 — Factory-programmed device data (read-only)

## Interrupts
0 PMCU_INT (SYSCTL) — PMCU_INT interrupt
1 DEBUG_INT (DEBUGSS) — DEBUG_INT interrupt
2 FLASH_INT (NVMNW) — FLASH_INT interrupt
3 WWDT0_INT (WWDT) — WWDT0_INT interrupt
4 GPIO0_INT (GPIO0) — GPIO0_INT interrupt
5 GPIO1_INT (GPIO1) — GPIO1_INT interrupt
6 GPIO2_INT (GPIO2) — GPIO2_INT interrupt
7 GPIO3_INT (GPIO3) — GPIO3_INT interrupt
8 ADC0_INT1_INT (ADC0) — ADC0_INT1_INT interrupt
9 ADC0_INT2_INT (ADC0) — ADC0_INT2_INT interrupt
10 ADC0_INT3_INT (ADC0) — ADC0_INT3_INT interrupt
11 ADC0_INT4_INT (ADC0) — ADC0_INT4_INT interrupt
12 ADC0_EVT_INT (ADC0) — ADC0_EVT_INT interrupt
13 ADC1_INT1_INT (ADC1) — ADC1_INT1_INT interrupt
14 ADC1_INT2_INT (ADC1) — ADC1_INT2_INT interrupt
15 ADC1_INT3_INT (ADC1) — ADC1_INT3_INT interrupt
16 ADC1_INT4_INT (ADC1) — ADC1_INT4_INT interrupt
17 ADC1_EVT_INT (ADC1) — ADC1_EVT_INT interrupt
18 ADC2_INT1_INT (ADC2) — ADC2_INT1_INT interrupt
19 ADC2_INT2_INT (ADC2) — ADC2_INT2_INT interrupt
20 ADC2_INT3_INT (ADC2) — ADC2_INT3_INT interrupt
21 ADC2_INT4_INT (ADC2) — ADC2_INT4_INT interrupt
22 ADC2_EVT_INT (ADC2) — ADC2_EVT_INT interrupt
23 MCAN0_INT (MCAN) — MCAN0_INT interrupt
24 MCPWM0_INT (MCPWM0) — MCPWM0_INT interrupt
25 MCPWM1_INT (MCPWM1) — MCPWM1_INT interrupt
26 MCPWM2_INT (MCPWM2) — MCPWM2_INT interrupt
27 MCPWM3_INT (MCPWM3) — MCPWM3_INT interrupt
28 MCPWM4_INT (MCPWM4) — MCPWM4_INT interrupt
29 ECAP0_INT (ECAP0) — ECAP0_INT interrupt
30 ECAP1_INT (ECAP1) — ECAP1_INT interrupt
31 EQEP0_INT (EQEP0) — EQEP0_INT interrupt
32 EQEP1_INT (EQEP1) — EQEP1_INT interrupt
33 EQEP2_INT (EQEP2) — EQEP2_INT interrupt
34 UC0_INT (UNICOMM0) — UC0_INT interrupt
35 UC1_INT (UNICOMM1) — UC1_INT interrupt
36 UC2_INT (UNICOMM2) — UC2_INT interrupt
37 UC3_INT (UNICOMM3) — UC3_INT interrupt
38 UC4_INT (UNICOMM4) — UC4_INT interrupt
39 UC5_INT (UNICOMM5) — UC5_INT interrupt
40 DMA0_INT (DMA) — DMA0_INT interrupt
41 TINIE_LITE_INT (TINIELITE) — TINIE_LITE_INT interrupt
42 EPI_INT (EPI0) — EPI_INT interrupt
43 AES_INT (AES) — AES_INT interrupt
44 TIMG4_0_INT (TIMG4) — TIMG4_0_INT interrupt
45 TIMG12_0_INT (TIMG12) — TIMG12_0_INT interrupt
46 TMU_LUF_INT (SYSCTL) — TMU_LUF_INT interrupt
47 TMU_LVF_INT (SYSCTL) — TMU_LVF_INT interrupt

## Licence text in the file
Copyright (C) 2025 Texas Instruments Incorporated - http://www.ti.com/ Redistribution and use in source and binary forms, with or without modification, are permitted provided that the following conditions are met: Redistributions of source code must retain the above copyright notice, this list of conditions and the following disclaimer. Redistributions in binary form must reproduce the above copyright notice, this list of conditions and the following disclaimer in the documentation and/or other materials provided with the distribution. Neither the name of Texas Instruments Incorporated nor the names of its contributors may be used to endorse or promote products derived from this software without specific prior written permission. THIS SOFTWARE IS PROVIDED BY THE COPYRIGHT HOLDERS AND CONTRIBUTORS "AS IS" AND ANY EXPRESS OR IMPLIED WARRANTIES, INCLUDING, BUT NOT LIMITED TO, THE IMPLIED WARRANTIES OF MERCHANTABILITY AND FITNESS FOR A PARTICULAR PURPOSE ARE DISCLAIMED. IN NO EVENT SHALL THE COPYRIGHT OWNER OR CONTRIBUTORS BE LIABLE FOR ANY DIRECT, INDIRECT, INCIDENTAL, SPECIAL, EXEMPLARY, OR CONSEQUENTIAL DAMAGES (INCLUDING, BUT NOT LIMITED TO, PROCUREMENT OF SUBSTITUTE GOODS OR SERVICES; LOSS OF USE, DATA, OR PROFITS; OR BUSINESS INTERRUPTION) HOWEVER CAUSED AND ON ANY THEORY OF LIABILITY, WHETHER IN CONTRACT, STRICT LIABILITY, OR TORT (INCLUDING NEGLIGENCE OR OTHERWISE) ARISING IN ANY WAY OUT OF THE USE OF THIS SOFTWARE, EVEN IF ADVISED OF THE POSSIBILITY OF SUCH DAMAGE.
